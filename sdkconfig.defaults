## sdkconfig.defaults
```kconfig
CONFIG_IDF_TARGET="esp32c3"
CONFIG_IDF_TARGET_ESP32C3=y


CONFIG_ESPTOOLPY_FLASHSIZE_4MB=y
CONFIG_ESPTOOLPY_FLASHSIZE="4MB"

CONFIG_PARTITION_TABLE_SINGLE_APP_LARGE=y

CONFIG_ESP_CONSOLE_SECONDARY_NONE=y


CONFIG_LWIP_IPV6=n

# FreeRTOS
CONFIG_FREERTOS_HZ=1000
CONFIG_FREERTOS_USE_STATS_FORMATTING_FUNCTIONS=y
CONFIG_FREERTOS_GENERATE_RUN_TIME_STATS=y
CONFIG_FREERTOS_CHECK_STACKOVERFLOW_CANARY=y
CONFIG_FREERTOS_USE_APPLICATION_TASK_TAG=y



# Logger
CONFIG_LOG_DEFAULT_LEVEL_INFO=y
CONFIG_LOG_MAXIMUM_LEVEL_DEBUG=y
CONFIG_LOG_MAXIMUM_LEVEL=4



# HTTP Server
CONFIG_HTTPD_MAX_REQ_HDR_LEN=512
CONFIG_HTTPD_MAX_URI_LEN=256
CONFIG_HTTPD_WS_SUPPORT=y

# WebSocket
CONFIG_HTTPD_WS_SUPPORT=y

# UART Configuration
CONFIG_UART_ISR_IN_IRAM=y
# CONFIG_UART_RXBUF_SIZE=1024


CONFIG_ESP_CONSOLE_USB_SERIAL_JTAG=y
CONFIG_ESP_CONSOLE_USB_SERIAL_JTAG_ENABLED=y


# Heap memory debugging
CONFIG_HEAP_POISONING_COMPREHENSIVE=y
CONFIG_HEAP_TRACING_STANDALONE=y
CONFIG_HEAP_TRACING=y
CONFIG_HEAP_TRACING_STACK_DEPTH=0
CONFIG_HEAP_ABORT_WHEN_ALLOCATION_FAILS=y 
# CONFIG_HEAP_TASK_TRACKING=y


#CONFIG_COMPILER_CXX_EXCEPTIONS=y
#CONFIG_COMPILER_CXX_EXCEPTIONS_EMG_POOL_SIZE=0

CONFIG_COMPILER_STACK_CHECK_MODE_ALL=y
CONFIG_COMPILER_STACK_CHECK=y

#CONFIG_COMPILER_STATIC_ANALYZER=y
```
